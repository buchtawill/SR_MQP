## petalinux/kv260_plnx_proj/project-spec/configs/rootfsconfigs/Kconfig.user
```kconfig
menu "user packages " 
config add-mult-test  
	 bool "add-mult-test"
	 help
	
config interpolate2x  
	 bool "interpolate2x"
	 help
	
config jiffies-test  
	 bool "jiffies-test"
	 help
	
config print-fb-info  
	 bool "print-fb-info"
	 help
	
config v4l-to-fb0-aligned  
	 bool "v4l-to-fb0-aligned"
	 help
	
config v4l-to-fb0-dma  
	 bool "v4l-to-fb0-dma"
	 help
	
endmenu
```

## petalinux/zcu102_plnx_proj/project-spec/configs/rootfsconfigs/Kconfig.user
```kconfig
menu "user packages " 
config gpio-demo  
	 bool "gpio-demo"
	 help
	
config peekpoke  
	 bool "peekpoke"
	 help
	
config upscale-zcu102  
	 bool "upscale-zcu102"
	 help
	
endmenu
```
